## CMakeLists.txt
```
cmake_minimum_required(VERSION 3.20.0)

set(EXTRA_CONF_FILE "secrets.conf")

find_package(Zephyr REQUIRED HINTS $ENV{ZEPHYR_BASE})
project(qoraal_test)

# target_sources(app PRIVATE src/main.c)
set(TEST_SRCS
    ../main.c
    src/platform.c
)
target_sources(app PRIVATE ${TEST_SRCS})


set(QORAAL_ROOT ${CMAKE_CURRENT_LIST_DIR}/../..)

add_subdirectory(
    ${QORAAL_ROOT}
    ${CMAKE_CURRENT_BINARY_DIR}/qoraal
)

# Suppose the library defined in the repo is called "qoraal"
target_link_libraries(qoraal      PUBLIC zephyr_interface)
target_link_libraries(qoraal-http PUBLIC zephyr_interface)
target_link_libraries(qoraal-engine PUBLIC zephyr_interface)
target_link_libraries(qoraal-tictactoe PUBLIC zephyr_interface)

target_compile_definitions(qoraal PRIVATE CFG_OS_ZEPHYR=1)
target_compile_definitions(qoraal-http PUBLIC CFG_OS_ZEPHYR=1 
                                CFG_HTTPSERVER_TLS_DISABLE=1  
                                CFG_HTTPCLIENT_TLS_DISABLE=1)
target_compile_definitions(qoraal-engine PUBLIC CFG_OS_ZEPHYR=1)
target_compile_definitions(qoraal-tictactoe PUBLIC CFG_OS_ZEPHYR=1
                                CFG_HTTPSERVER_TLS_DISABLE=1)   

target_compile_options(app PRIVATE -O0 -g)
target_compile_options(qoraal PRIVATE -O0 -g)
target_compile_options(qoraal-http PRIVATE -O0 -g)
target_compile_options(qoraal-engine PRIVATE -O0 -g)
target_compile_options(qoraal-tictactoe PRIVATE -O0 -g)

# link tictactoe.e as binary blob:
set(BLOB_SRC    ${QORAAL_ROOT}/tictactoe.e)
set(BLOB_SIMPLE ${CMAKE_CURRENT_BINARY_DIR}/tictactoe_e)   # no ext, no path
set(BLOB_OBJ    ${CMAKE_CURRENT_BINARY_DIR}/tictactoe_e.o)

# Step 0: copy to a simple name in the build dir
add_custom_command(
  OUTPUT ${BLOB_SIMPLE}
  COMMAND ${CMAKE_COMMAND} -E copy ${BLOB_SRC} ${BLOB_SIMPLE}
  DEPENDS ${BLOB_SRC}
  COMMENT "Copy tictactoe.e -> ${BLOB_SIMPLE}"
)

# Step 1: run objcopy FROM the build dir so symbols don't include a path
add_custom_command(
  OUTPUT ${BLOB_OBJ}
  WORKING_DIRECTORY ${CMAKE_CURRENT_BINARY_DIR}
  COMMAND ${CMAKE_OBJCOPY}
          -I binary -O elf32-littlearm -B arm
          --rename-section .data=.rodata.tictactoe,alloc,load,readonly,data,contents
          tictactoe_e tictactoe_e.o
  DEPENDS ${BLOB_SIMPLE}
  COMMENT "Embedding tictactoe_e -> tictactoe_e.o with short symbols"
)

target_sources(app PRIVATE ${BLOB_OBJ})

zephyr_linker_sources(SECTIONS src/zephyr.ld)

target_link_libraries(app PRIVATE   qoraal 
                                    qoraal-http 
                                    qoraal-engine 
                                    qoraal-tictactoe)
```

## prj.conf
```kconfig
# --- Debug
#CONFIG_SYS_HEAP_RUNTIME_STATS=y

# --- Core
CONFIG_MAIN_STACK_SIZE=8192
CONFIG_SYSTEM_WORKQUEUE_STACK_SIZE=4096
CONFIG_TIMESLICING=y
CONFIG_EVENTS=y
CONFIG_THREAD_CUSTOM_DATA=y

# --- Console / logging
CONFIG_CONSOLE_SUBSYS=y
CONFIG_CONSOLE_GETCHAR=y
CONFIG_LOG=y
CONFIG_LOG_MODE_DEFERRED=y
CONFIG_LOG_DEFAULT_LEVEL=3
CONFIG_LOG_PRINTK=y
CONFIG_LOG_BACKEND_UART=y
CONFIG_UART_INTERRUPT_DRIVEN=y

# --- Network (generic)
CONFIG_NETWORKING=y
CONFIG_NET_L2_ETHERNET=y
CONFIG_NET_SOCKETS=y
CONFIG_NET_IPV4=y
CONFIG_NET_UDP=y
CONFIG_NET_TCP=y
CONFIG_NET_DHCPV4=y
CONFIG_NET_TCP_TIME_WAIT_DELAY=250
CONFIG_DNS_RESOLVER=y

# --- Storage (generic)
CONFIG_SPI=y
CONFIG_SPI_NOR=y
CONFIG_FLASH=y
CONFIG_FLASH_MAP=y
CONFIG_FLASH_PAGE_LAYOUT=y
CONFIG_PARTITION_MANAGER_ENABLED=y
CONFIG_FILE_SYSTEM=y
CONFIG_FILE_SYSTEM_LITTLEFS=y
CONFIG_FILE_SYSTEM_MKFS=y
CONFIG_FS_LITTLEFS_CACHE_SIZE=128
CONFIG_FS_LITTLEFS_NUM_FILES=6
CONFIG_FS_LITTLEFS_FMP_DEV=y
CONFIG_MPU_ALLOW_FLASH_WRITE=y

# --- WiFi / WPA
CONFIG_WIFI_CREDENTIALS_STATIC=y

# --- Enable core crypto
# TLS over sockets (needed for IPPROTO_TLS_1_2) ---
CONFIG_NET_SOCKETS_SOCKOPT_TLS=n
CONFIG_MBEDTLS=y
CONFIG_MBEDTLS_AES_ROM_TABLES=y
CONFIG_MBEDTLS_SSL_OUT_CONTENT_LEN=4096
# CONFIG_MBEDTLS_SSL_IN_CONTENT_LEN=4096

#CONFIG_MBEDTLS_HEAP_SIZE=0
CONFIG_MBEDTLS_SSL_PROTO_TLS1_2=y
# Key exchange & curves: keep only P-256 ECDHE+ECDSA
CONFIG_MBEDTLS_ECP_C=y
CONFIG_MBEDTLS_ECP_DP_SECP256R1_ENABLED=y
CONFIG_MBEDTLS_ECP_DP_SECP384R1_ENABLED=n
CONFIG_MBEDTLS_ECP_ALL_ENABLED=n
CONFIG_MBEDTLS_ECDSA_C=y
# If you don’t need RSA at all:
CONFIG_MBEDTLS_RSA_C=y
CONFIG_MBEDTLS_PKCS1_V15=y
CONFIG_MBEDTLS_PKCS1_V21=y
# Ciphers: keep AES-128-GCM only if that’s what your server supports
CONFIG_MBEDTLS_AES_C=y
CONFIG_MBEDTLS_GCM_C=y
CONFIG_MBEDTLS_CCM_C=n
# X.509 parse only (no create/CSR)
CONFIG_MBEDTLS_X509_USE_C=y
CONFIG_MBEDTLS_X509_CRT_PARSE_C=y
CONFIG_MBEDTLS_X509_CREATE_C=y
CONFIG_MBEDTLS_X509_CSR_WRITE_C=y
CONFIG_MBEDTLS_PK_PARSE_C=y
# Prefer DER; drop PEM if you can
CONFIG_MBEDTLS_PEM_PARSE_C=y
# No CRL unless you really need it
CONFIG_MBEDTLS_X509_CRL_PARSE_C=n
CONFIG_MBEDTLS_ECDH_C=y
CONFIG_MBEDTLS_SHA256_C=y
# --- Enable the ECDHE_RSA key exchange (client can then pick either ECDSA or RSA) ---
CONFIG_MBEDTLS_KEY_EXCHANGE_ECDHE_RSA_ENABLED=y
# --- Let the client send SNI (required to call mbedtls_ssl_set_hostname) ---
CONFIG_MBEDTLS_SSL_SERVER_NAME_INDICATION=y
# Allow RSA-4096 bignums
CONFIG_MBEDTLS_MPI_MAX_SIZE=512
CONFIG_MBEDTLS_KEY_EXCHANGE_ECDHE_ECDSA_ENABLED=y
CONFIG_MBEDTLS_SSL_TICKET_C=y
CONFIG_MBEDTLS_SSL_SESSION_TICKETS=y
CONFIG_MBEDTLS_SSL_SRV_C=y
CONFIG_MBEDTLS_SSL_CLI_C=y
```

## boards/nrf7002dk_nrf5340_cpuapp.conf
```kconfig
# WiFi / WPA
CONFIG_WIFI=y
CONFIG_WIFI_NRF70=y
CONFIG_WIFI_NM_WPA_SUPPLICANT=y

# Nordic driver behavior
CONFIG_NRF_WIFI_LOW_POWER=y
CONFIG_NRF_WIFI_RPU_RECOVERY=y
CONFIG_WIFI_READY_LIB=y




# =========================
# nRF70 Wi-Fi driver buffers
# =========================
# Number of RX buffers owned by the nRF70 driver itself.
# Too low → RX stalls/drops under load; too high → eats SRAM fast.
CONFIG_NRF70_RX_NUM_BUFS=12

# =========================
# net_pkt slab counts (packet headers / bookkeeping)
# =========================
# net_pkt objects are the "packet descriptors" (metadata + fragment chain pointers).
# If these max out you’ll see TX/RX slab pressure and allocation FAILs.
CONFIG_NET_PKT_RX_COUNT=16
CONFIG_NET_PKT_TX_COUNT=12

# =========================
# net_buf fragment pools (payload fragments)
# =========================
# Fragment buffers that carry actual packet data.
# Counts control how many fragments can be in flight; size controls fragmentation vs RAM.
# - Larger DATA_SIZE → fewer fragments / less CPU, but more RAM per buffer.
# - More COUNT → handles bursts / parallel TCP streams, but more RAM reserved.
CONFIG_NET_BUF_RX_COUNT=40
CONFIG_NET_BUF_TX_COUNT=16
CONFIG_NET_BUF_FIXED_DATA_SIZE=y
CONFIG_NET_BUF_DATA_SIZE=512

# =========================
# Socket/context limits (how many sockets the system can juggle)
# =========================
# net_context objects back sockets; max_conn limits connections; poll/open/eventfd
# limits must be consistent or you’ll hit "weird" runtime ceilings.
CONFIG_NET_MAX_CONTEXTS=16
CONFIG_NET_MAX_CONN=16
CONFIG_ZVFS_POLL_MAX=16
CONFIG_ZVFS_OPEN_MAX=32
CONFIG_ZVFS_EVENTFD_MAX=32

# =========================
# Receive processing
# =========================
# reduces memory presure on receive queues
CONFIG_NET_CONTEXT_SYNC_RECV=y

# =========================
# TCP window sizing (throughput vs buffering pressure)
# =========================
# 0 means "use Zephyr defaults". Setting explicit smaller windows can reduce
# buffering pressure (and RAM churn) but may reduce throughput, especially on
# higher-latency links.
CONFIG_NET_TCP_MAX_RECV_WINDOW_SIZE=0
CONFIG_NET_TCP_MAX_SEND_WINDOW_SIZE=0

# =========================
# Global heaps
# =========================
# Use the _system_heap and not a dedicated heap form k_malloc and k_free
CONFIG_HEAP_MEM_POOL_SIZE=0
CONFIG_HEAP_MEM_POOL_IGNORE_MIN=n

# =========================
# nRF Wi-Fi global heap
# =========================
# This heap is used by the Wi-Fi stack/driver for internal allocations.
# uncomment the following line to put the wifi on the system heap
# CONFIG_NRF_WIFI_GLOBAL_HEAP=y
CONFIG_NRF_WIFI_CTRL_HEAP_SIZE=16384
CONFIG_NRF_WIFI_DATA_HEAP_SIZE=32768

# =========================
# MbedTLS global heap
# =========================
# Disable to use RamRaven heap
CONFIG_MBEDTLS_ENABLE_HEAP=y
CONFIG_MBEDTLS_HEAP_SIZE=65536



#CONFIG_COMMON_LIBC_MALLOC=n
#CONFIG_NEWLIB_LIBC=n
#CONFIG_COMMON_LIBC_MALLOC_ARENA_SIZE=0
```

## src/platform.c
```c
/*
 *  Copyright (C) 2015-2025, Navaro, All Rights Reserved
 *  SPDX-License-Identifier: Apache-2.0
 *
 *  Licensed under the Apache License, Version 2.0 (the "License"); you may
 *  not use this file except in compliance with the License.
 *  You may obtain a copy of the License at
 *
 *  http://www.apache.org/licenses/LICENSE-2.0
 *
 *  Unless required by applicable law or agreed to in writing, software
 *  distributed under the License is distributed on an "AS IS" BASIS, WITHOUT
 *  WARRANTIES OR CONDITIONS OF ANY KIND, either express or implied.
 *  See the License for the specific language governing permissions and
 *  limitations under the License.
 *
 *  This file is part of CORAL Connect (https://navaro.nl)
 */


#if defined CFG_OS_ZEPHYR

#include <zephyr/logging/log.h>
LOG_MODULE_REGISTER(sta, CONFIG_LOG_DEFAULT_LEVEL);

#include <zephyr/kernel.h>
#include <stdio.h>
#include <stdlib.h>
#include <zephyr/shell/shell.h>
#include <zephyr/sys/printk.h>
#include <zephyr/init.h>

#include <zephyr/net/net_if.h>
#include <zephyr/net/wifi_mgmt.h>
#include <zephyr/net/net_event.h>
#include <zephyr/drivers/gpio.h>

#include <zephyr/console/console.h>
#include <stdio.h>
#include <string.h>

#include <zephyr/devicetree.h>
#include <zephyr/storage/flash_map.h>
#include <zephyr/fs/fs.h>
#include <zephyr/fs/littlefs.h>
#include <zephyr/device.h>

#include <zephyr/net/net_core.h>
#include <zephyr/net/net_pkt.h>
#include <net/wifi_ready.h>

#include <zephyr/storage/flash_map.h>
#include <pm_config.h>

#include "qoraal/qoraal.h"
#include "qoraal/svc/svc_services.h"
#include "qoraal/svc/svc_shell.h"
#include "qoraal/platform.h"
#include "qoraal/qshell/console.h"
#include "qoraal-http/qoraal.h"
#include "qoraal-http/mbedtls/mbedtlsutils.h"

#include <zephyr/net/net_if.h>
#include <zephyr/net/net_ip.h>
#include <zephyr/net/dhcpv4.h>

#define 	WIFI_STATIC_IPV4_ADDR       "192.168.1.99"
#define  	WIFI_STATIC_IPV4_NETMASK    "255.255.255.0"
#define  	WIFI_STATIC_IPV4_GW         "192.168.1.1"


#if !IS_ENABLED(CONFIG_PARTITION_MANAGER_ENABLED)
#error "PM is not enabled; you will NOT get the PM flash map."
#endif

#define WIFI_SHELL_MGMT_EVENTS              (NET_EVENT_WIFI_CONNECT_RESULT | NET_EVENT_WIFI_DISCONNECT_RESULT)

static void wifi_ready_cb(bool wifi_ready);
static void wifi_mgmt_event_handler(struct net_mgmt_event_callback *cb, uint32_t mgmt_event, struct net_if *iface) ;
static void net_mgmt_event_handler(struct net_mgmt_event_callback *cb, uint32_t mgmt_event, struct net_if *iface) ;


static void wifi_connect_work_handler(struct k_work *work) ;
#define WIFI_WQ_STACK_SIZE 8192
#define WIFI_WQ_PRIORITY   5   /* Higher number = lower priority (preemptive) */

K_THREAD_STACK_DEFINE(wifi_wq_stack, WIFI_WQ_STACK_SIZE);
static struct k_work_q wifi_wq;
static struct k_work wifi_connect_work;


static struct net_mgmt_event_callback wifi_shell_mgmt_cb;
static struct net_mgmt_event_callback net_shell_mgmt_cb;


static struct {
	const struct shell *sh;
	union {
		struct {
			uint8_t connected	: 1;
			uint8_t connect_result	: 1;
			uint8_t disconnect_requested	: 1;
			uint8_t _unused		: 5;
		};
		uint8_t all;
	};
} wifi_context;

/* PM route (recommended in NCS): pm_static.yml defines a partition named "littlefs" */
#define LFS_DEV_ID  ((uintptr_t)FLASH_AREA_ID(lfs_ext))
FS_LITTLEFS_DECLARE_DEFAULT_CONFIG(lfs_cfg);
struct fs_mount_t lfs_mnt = {
	.type = FS_LITTLEFS, .mnt_point = "/lfs",
	.storage_dev = (void *)LFS_DEV_ID, 
	.fs_data = &lfs_cfg,
};

static uint32_t _platform_flash_size;

void
platform_init_wifi (void)
{

    /* Start low-priority workqueue */
    k_work_queue_start( &wifi_wq,  wifi_wq_stack, 
            K_THREAD_STACK_SIZEOF(wifi_wq_stack), WIFI_WQ_PRIORITY, NULL );

    k_work_init(&wifi_connect_work, wifi_connect_work_handler);

    // Littlefs mount
    const struct flash_area *fa;
    int rc = flash_area_open((uintptr_t)lfs_mnt.storage_dev, &fa);
    if (rc == 0) {
        flash_area_close(fa);

        rc = fs_mount(&lfs_mnt);
        if (rc == -ENODEV) { /* optional mkfs-on-first-boot */
                (void)fs_mkfs(FS_LITTLEFS, (uintptr_t)lfs_mnt.storage_dev, lfs_mnt.fs_data, 0);
                rc = fs_mount(&lfs_mnt);
        }
    }
    struct fs_statvfs st;
    rc = fs_statvfs("/lfs", &st);
    if (!rc) {
            printk("%s: bsize=%lu frsize=%lu blocks=%lu bfree=%lu (~%lu KiB total)\n",
            "/lfs", (unsigned long)st.f_bsize, (unsigned long)st.f_frsize,
            (unsigned long)st.f_blocks, (unsigned long)st.f_bfree,
            (unsigned long)(st.f_blocks * st.f_frsize / 1024));
    } else {
            printk("statvfs(%s) rc=%d\n", "/lfs", rc);
    }

    // WiFi connect
    memset(&wifi_context, 0, sizeof(wifi_context));
	net_mgmt_init_event_callback(&wifi_shell_mgmt_cb,
				     wifi_mgmt_event_handler,
				     WIFI_SHELL_MGMT_EVENTS);
	net_mgmt_add_event_callback(&wifi_shell_mgmt_cb);
	net_mgmt_init_event_callback(&net_shell_mgmt_cb,
				     net_mgmt_event_handler,
				     NET_EVENT_IPV4_DHCP_BOUND);
	net_mgmt_add_event_callback(&net_shell_mgmt_cb);

    wifi_ready_callback_t cb;
	struct net_if *iface = net_if_get_first_wifi();

	if (!iface) {
		LOG_ERR("Failed to get Wi-Fi interface");
		return ;
	}

	cb.wifi_ready_cb = wifi_ready_cb;

	LOG_DBG("Registering Wi-Fi ready callbacks");
	rc = register_wifi_ready_callback(cb, iface);
	if (rc) {
		LOG_ERR("Failed to register Wi-Fi ready callbacks %s", strerror(rc));
		return ;
	}


	LOG_INF("Starting %s with CPU frequency: %d MHz", CONFIG_BOARD, SystemCoreClock/MHZ(1));
	k_sleep(K_SECONDS(1));

    return ;
}

int32_t
platform_init(uint32_t flash_size)
{
    _platform_flash_size = flash_size;
    console_init();
#if !defined(CFG_HTTPCLIENT_TLS_DISABLE) || !CFG_HTTPCLIENT_TLS_DISABLE
    mbedtlsutils_init();
#endif
    return 0;
}

int32_t
platform_start(void)
{
    ARG_UNUSED(_platform_flash_size);
#if !defined(CFG_HTTPCLIENT_TLS_DISABLE) || !CFG_HTTPCLIENT_TLS_DISABLE
    mbedtlsutils_start( 0 ) ;
#endif
    platform_init_wifi();

    
    return 0;
}

int32_t
platform_stop(void)
{
    return 0;
}

void *
platform_malloc(QORAAL_HEAP heap, size_t size)
{
    ARG_UNUSED(heap);
    return malloc(size);
}

void
platform_free(QORAAL_HEAP heap, void *mem)
{
    ARG_UNUSED(heap);
    free(mem);
}

void
platform_print(const char *format)
{
    console_write (0, format, strlen(format)) ;
}

int32_t 
platform_getch (uint32_t timeout_ms)
{
    return console_getchar(); 
}

void
platform_assert(const char *format)
{
    printk("%s", format);
    k_oops();
}

uint32_t
platform_current_time(void)
{
    return k_uptime_get_32() / 1000U;
}

uint32_t
platform_rand(void)
{
    return rand();
}

uint32_t
platform_wdt_kick(void)
{
    return 20U;
}

int32_t
platform_flash_erase(uint32_t addr_start, uint32_t addr_end)
{
    ARG_UNUSED(addr_start);
    ARG_UNUSED(addr_end);
    return E_NOIMPL;
}

int32_t
platform_flash_write(uint32_t addr, uint32_t len, const uint8_t *data)
{
    ARG_UNUSED(addr);
    ARG_UNUSED(len);
    ARG_UNUSED(data);
    return E_NOIMPL;
}

int32_t
platform_flash_read(uint32_t addr, uint32_t len, uint8_t *data)
{
    ARG_UNUSED(addr);
    ARG_UNUSED(len);
    ARG_UNUSED(data);
    return E_NOIMPL;
}


static void wifi_connect_work_handler(struct k_work *work) 
{
	struct net_if *iface = net_if_get_first_wifi();

	wifi_context.connected = false;
	wifi_context.connect_result = false;

    struct wifi_connect_req_params params = { 0 };
    params.ssid = CONFIG_WIFI_CREDENTIALS_STATIC_SSID;
    params.ssid_length = strlen(CONFIG_WIFI_CREDENTIALS_STATIC_SSID);
    params.psk = CONFIG_WIFI_CREDENTIALS_STATIC_PASSWORD;
    params.psk_length = strlen(CONFIG_WIFI_CREDENTIALS_STATIC_PASSWORD);
    params.security = WIFI_SECURITY_TYPE_PSK;
    params.channel = WIFI_CHANNEL_ANY;
    params.mfp = WIFI_MFP_OPTIONAL;

    int res = net_mgmt(NET_REQUEST_WIFI_CONNECT, iface, &params,
                    sizeof(params));

    LOG_INF("Connection requested: %d", res);
}

static void wifi_ready_cb(bool wifi_ready)
{
	LOG_INF("Is Wi-Fi ready?: %s", wifi_ready ? "yes" : "no");
	if (wifi_ready) {
		k_work_submit_to_queue(&wifi_wq, &wifi_connect_work);
	}

}

static int cmd_wifi_status(void)
{
	struct net_if *iface = net_if_get_default();
	struct wifi_iface_status status = { 0 };

	if (net_mgmt(NET_REQUEST_WIFI_IFACE_STATUS, iface, &status,
				sizeof(struct wifi_iface_status))) {
		LOG_INF("Status request failed");

		return -ENOEXEC;
	}

	LOG_INF("==================");
	LOG_INF("State: %s", wifi_state_txt(status.state));

	if (status.state >= WIFI_STATE_ASSOCIATED) {
		uint8_t mac_string_buf[sizeof("xx:xx:xx:xx:xx:xx")];

		LOG_INF("Interface Mode: %s",
		       wifi_mode_txt(status.iface_mode));
		LOG_INF("Link Mode: %s",
		       wifi_link_mode_txt(status.link_mode));
		LOG_INF("SSID: %.32s", status.ssid);
		LOG_INF("BSSID: %s",
		       (char *)net_sprint_ll_addr_buf(
				status.bssid, WIFI_MAC_ADDR_LEN,
				mac_string_buf, sizeof(mac_string_buf)));
		LOG_INF("Band: %s", wifi_band_txt(status.band));
		LOG_INF("Channel: %d", status.channel);
		LOG_INF("Security: %s", wifi_security_txt(status.security));
		LOG_INF("MFP: %s", wifi_mfp_txt(status.mfp));
		LOG_INF("RSSI: %d", status.rssi);
	}
	return 0;
}

static void wifi_mgmt_event_handler(struct net_mgmt_event_callback *cb,
				     uint32_t mgmt_event, struct net_if *iface)
{
	switch (mgmt_event) {
	case NET_EVENT_WIFI_CONNECT_RESULT: {
        const struct wifi_status *status =
            (const struct wifi_status *) cb->info;

        if (wifi_context.connected) {
            break;
        }
        if (status->status) {
            LOG_ERR("Connection failed (%d)", status->status);
        } else {
            LOG_INF("Connected");
            wifi_context.connected = true;
        }
        wifi_context.connect_result = true;       
        
        cmd_wifi_status();    
    }
	break;
	case NET_EVENT_WIFI_DISCONNECT_RESULT: {
        const struct wifi_status *status =
            (const struct wifi_status *) cb->info;

        if (!wifi_context.connected) {
            return;
        }

        if (wifi_context.disconnect_requested) {
            LOG_INF("Disconnection request %s (%d)",
                status->status ? "failed" : "done",
                        status->status);
            wifi_context.disconnect_requested = false;
        } else {
            LOG_INF("Received Disconnected");
            wifi_context.connected = false;
        }

        cmd_wifi_status();        
    }
	break;
	default:
		break;
	}
}


static void net_mgmt_event_handler(struct net_mgmt_event_callback *cb,
				    uint32_t mgmt_event, struct net_if *iface)
{
	switch (mgmt_event) {
	case NET_EVENT_IPV4_DHCP_BOUND: {
        /* Get DHCP info from struct net_if_dhcpv4 and print */
        const struct net_if_dhcpv4 *dhcpv4 = cb->info;
        const struct in_addr *addr = &dhcpv4->requested_ip;
        char dhcp_info[128];

        net_addr_ntop(AF_INET, addr, dhcp_info, sizeof(dhcp_info));

        LOG_INF("DHCP IP address: %s", dhcp_info);

    }
	break;
	default:
	break;
	}
}


static int32_t
qshell_wifi (SVC_SHELL_IF_T * pif, char** argv, int argc)
{

    svc_shell_print (pif, SVC_SHELL_OUT_STD,
                "WiFi Status:\r\n") ;

	struct net_if *iface = net_if_get_default();
	struct wifi_iface_status status = { 0 };

	if (net_mgmt(NET_REQUEST_WIFI_IFACE_STATUS, iface, &status,
				sizeof(struct wifi_iface_status))) {
		svc_shell_print(pif, SVC_SHELL_OUT_STD,
            "Status request failed");

		return -ENOEXEC;
	}

	svc_shell_print(pif, SVC_SHELL_OUT_STD,
            "==================");
	svc_shell_print(pif, SVC_SHELL_OUT_STD,
            "State: %s", wifi_state_txt(status.state));

	if (status.state >= WIFI_STATE_ASSOCIATED) {
		uint8_t mac_string_buf[sizeof("xx:xx:xx:xx:xx:xx")];

		svc_shell_print(pif, SVC_SHELL_OUT_STD,
            "Interface Mode: %s",
		       wifi_mode_txt(status.iface_mode));
		svc_shell_print(pif, SVC_SHELL_OUT_STD,
            "Link Mode: %s",
		       wifi_link_mode_txt(status.link_mode));
		svc_shell_print(pif, SVC_SHELL_OUT_STD,
            "SSID: %.32s", status.ssid);
		svc_shell_print(pif, SVC_SHELL_OUT_STD,
            "BSSID: %s",
		       net_sprint_ll_addr_buf(
				status.bssid, WIFI_MAC_ADDR_LEN,
				mac_string_buf, sizeof(mac_string_buf)));
		svc_shell_print(pif, SVC_SHELL_OUT_STD,
            "Band: %s", wifi_band_txt(status.band));
		svc_shell_print(pif, SVC_SHELL_OUT_STD,
            "Channel: %d", status.channel);
		svc_shell_print(pif, SVC_SHELL_OUT_STD,
            "Security: %s", wifi_security_txt(status.security));
		svc_shell_print(pif, SVC_SHELL_OUT_STD,
            "MFP: %s", wifi_mfp_txt(status.mfp));
		svc_shell_print(pif, SVC_SHELL_OUT_STD,
            "RSSI: %d", status.rssi);
	}

    return SVC_SHELL_CMD_E_OK ;

}
SVC_SHELL_CMD_DECL("wifi", qshell_wifi, "");



static int32_t
print_ip(SVC_SHELL_IF_T *pif)
{
    struct net_if *iface = net_if_get_first_wifi();
    struct net_if_ipv4 *ipv4;
    char ip_buf[NET_IPV4_ADDR_LEN];
    char nm_buf[NET_IPV4_ADDR_LEN];
    char gw_buf[NET_IPV4_ADDR_LEN];

    if (!iface) {
        svc_shell_print(pif, SVC_SHELL_OUT_STD,
                        "No Wi-Fi interface found\r\n");
        return SVC_SHELL_CMD_E_FAIL;
    }

    ipv4 = iface->config.ip.ipv4;
    if (!ipv4) {
        svc_shell_print(pif, SVC_SHELL_OUT_STD,
                        "IPv4 not enabled on interface\r\n");
        return SVC_SHELL_CMD_E_FAIL;
    }

    /* Find first used unicast IPv4 address */
    for (int i = 0; i < NET_IF_MAX_IPV4_ADDR; i++) {
        if (ipv4->unicast[i].ipv4.is_used) {

            net_addr_ntop(AF_INET,
                          &ipv4->unicast[i].ipv4.address.in_addr,
                          ip_buf, sizeof(ip_buf));

            net_addr_ntop(AF_INET,
                          &ipv4->unicast[i].netmask,
                          nm_buf, sizeof(nm_buf));

            net_addr_ntop(AF_INET,
                          &ipv4->gw,
                          gw_buf, sizeof(gw_buf));

            svc_shell_print(pif, SVC_SHELL_OUT_STD,
                            "IP: %s\r\nNetmask: %s\r\nGateway: %s\r\n",
                            ip_buf, nm_buf, gw_buf);

            return SVC_SHELL_CMD_E_OK;
        }
    }

    svc_shell_print(pif, SVC_SHELL_OUT_STD,
                    "No IPv4 address assigned\r\n");
    return SVC_SHELL_CMD_E_FAIL;
}



static int32_t
qshell_ifconfig(SVC_SHELL_IF_T *pif, char **argv, int argc)
{
    struct net_if *iface = net_if_get_first_wifi();
    struct in_addr ip, nm, gw;

    const char *ip_s = WIFI_STATIC_IPV4_ADDR;
    const char *nm_s = WIFI_STATIC_IPV4_NETMASK;
    const char *gw_s = WIFI_STATIC_IPV4_GW;

    char gw_buf[NET_IPV4_ADDR_LEN];

    if (!iface) {
        svc_shell_print(pif, SVC_SHELL_OUT_STD,
                        "No Wi-Fi interface found\r\n");
        return SVC_SHELL_CMD_E_FAIL;
    }

    /* Usage */
    if (argc < 2) {
        svc_shell_print(pif, SVC_SHELL_OUT_STD,
                        "Usage:\r\n"
                        "  ifconfig <ip> [netmask] [gateway]\r\n"
                        "\r\n");

        return print_ip (pif) ;
    }

    /* argv[0] is command name, argv[1..] are args */
    if (argc >= 2) ip_s = argv[1];
    if (argc >= 3) nm_s = argv[2];
    if (argc >= 4) gw_s = argv[3]; /* explicit gateway provided */

    if (net_addr_pton(AF_INET, ip_s, &ip)) {
        LOG_ERR("Bad static IP: %s", ip_s);
        return -EINVAL;
    }

    if (net_addr_pton(AF_INET, nm_s, &nm)) {
        LOG_ERR("Bad netmask: %s", nm_s);
        return -EINVAL;
    }

    /* If gateway not specified, derive it as network + 1 */
    if (argc < 4) {
        uint32_t ip_h = ntohl(ip.s_addr);
        uint32_t nm_h = ntohl(nm.s_addr);

        uint32_t net_h = ip_h & nm_h;
        uint32_t gw_h  = net_h + 1U;

        gw.s_addr = htonl(gw_h);

        /* for logging/printing */
        if (!net_addr_ntop(AF_INET, &gw, gw_buf, sizeof(gw_buf))) {
            LOG_ERR("Failed to format derived gateway");
            return -EIO;
        }
        gw_s = gw_buf;
    } else {
    if (net_addr_pton(AF_INET, gw_s, &gw)) {
        LOG_ERR("Bad gateway: %s", gw_s);
        return -EINVAL;
    }
    }

    /* Make sure DHCP isn't racing you */
#if IS_ENABLED(CONFIG_NET_DHCPV4)
    net_dhcpv4_stop(iface);
#endif

    /* Optional: clear old addresses */
    struct net_if_ipv4 *ipv4 = iface->config.ip.ipv4;
    if (ipv4) {
        for (int i = 0; i < NET_IF_MAX_IPV4_ADDR; i++) {
            if (ipv4->unicast[i].ipv4.is_used) {
                net_if_ipv4_addr_rm(iface, &ipv4->unicast[i].ipv4.address.in_addr);
            }
        }
    }

    net_if_ipv4_set_netmask(iface, &nm);
    net_if_ipv4_set_gw(iface, &gw);

    struct net_if_addr *ifaddr = net_if_ipv4_addr_add(iface, &ip, NET_ADDR_MANUAL, 0);
    if (!ifaddr) {
        LOG_ERR("Failed to add static IPv4 address");
        return -ENOMEM;
    }

    LOG_INF("Static IPv4 set: %s / %s gw %s", ip_s, nm_s, gw_s);

    svc_shell_print(pif, SVC_SHELL_OUT_STD,
                    "OK: IP=%s Netmask=%s Gateway=%s\r\n",
                    ip_s, nm_s, gw_s);

    return SVC_SHELL_CMD_E_OK;
}
SVC_SHELL_CMD_DECL("ifconfig", qshell_ifconfig, "");


#endif /* CFG_OS_ZEPHYR */
```
